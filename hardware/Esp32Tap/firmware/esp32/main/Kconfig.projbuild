## hardware/Esp32Tap/firmware/esp32/main/Kconfig.projbuild
```kconfig
menu "Esp32Tap"

    config ESP32TAP_WIFI_SSID
        string "WiFi SSID (bring-up fallback)"
        default ""
        help
            Station SSID used when NVS namespace "net" has no "ssid"
            key. Bring-up convenience only — production devices get
            credentials via NVS (softAP provisioning is a follow-up).

    config ESP32TAP_WIFI_PASS
        string "WiFi password (bring-up fallback)"
        default ""
        help
            Station password paired with ESP32TAP_WIFI_SSID.

endmenu
```

## hardware/Esp32Tap/firmware/esp32_rs/experiments/wdt_qemu_control/sdkconfig.defaults
```kconfig
CONFIG_IDF_TARGET="esp32s3"
CONFIG_IDF_TARGET_ESP32S3=y
CONFIG_FREERTOS_HZ=1000
CONFIG_ESP_TASK_WDT_EN=y
CONFIG_ESP_TASK_WDT_INIT=y
CONFIG_ESP_TASK_WDT_TIMEOUT_S=2
CONFIG_ESP_TASK_WDT_PANIC=y
CONFIG_ESP_SYSTEM_PANIC_PRINT_REBOOT=y
CONFIG_ESPTOOLPY_FLASHSIZE_8MB=y
```
